## esp32-mqtt-client/sdkconfig.defaults
```kconfig
CONFIG_MQTT_WIFI_SSID="YourWiFiSSID"
CONFIG_MQTT_WIFI_PASSWORD="YourWiFiPassword"
CONFIG_MQTT_BROKER_URI="mqtt://broker.hivemq.com"
CONFIG_MQTT_CLIENT_ID="smowcode-esp32-001"
CONFIG_MQTT_PUB_TOPIC="smowcode/sensors/telemetry"
CONFIG_MQTT_SUB_TOPIC="smowcode/commands/#"
CONFIG_ESP_MAIN_TASK_STACK_SIZE=8192
```

## esp32-wifi-ota/sdkconfig.defaults
```kconfig
CONFIG_OTA_WIFI_SSID="YourWiFiSSID"
CONFIG_OTA_WIFI_PASSWORD="YourWiFiPassword"
CONFIG_OTA_FIRMWARE_URL="https://your-ota-server.com/firmware/esp32-app.bin"
CONFIG_PARTITION_TABLE_TWO_OTA=y
CONFIG_BOOTLOADER_APP_ROLLBACK_ENABLE=y
CONFIG_ESP_MAIN_TASK_STACK_SIZE=8192
```
